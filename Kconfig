## Kconfig
```kconfig
# SPDX-License-Identifier: MIT
config ZMK_LINEA40_ENCODER_INERTIA
    bool "LiNEA40 rotary encoder inertial wheel scrolling"
    default y
    depends on ZMK_POINTING
    help
      Build the encoder-only inertial wheel scrolling behavior.
      The trackball input processor remains unchanged.
```

## dts/bindings/behaviors/zmk,behavior-inertial-scroll.yaml
```yaml
# SPDX-License-Identifier: MIT
description: LiNEA40 encoder-only inertial scrolling impulse

compatible: "zmk,behavior-inertial-scroll"

properties:
  "#binding-cells":
    type: int
    required: true
    const: 1
  frame-ms:
    type: int
    default: 16
  tail-frames:
    type: int
    default: 11
  rapid-threshold-ms:
    type: int
    default: 90
  grouping-threshold-ms:
    type: int
    default: 155
  rapid-impulse-q8:
    type: int
    default: 120
  grouped-impulse-q8:
    type: int
    default: 65
  velocity-cap-q8:
    type: int
    default: 400
  decay-percent:
    type: int
    default: 76
  slow-detent-ticks:
    type: int
    default: 2
  rapid-detent-ticks:
    type: int
    default: 1
  hires-detent-units:
    type: int
    default: 16
  hires-immediate-units:
    type: int
    default: 6
  hires-chunk-units:
    type: int
    default: 5
  encoder-trigger-divisor:
    type: int
    default: 3
    description: New encoder events per one previous coarse sensor event
  coast-wait-ms:
    type: int
    default: 55
    description: Idle time since the last detent before any synthetic glide starts
  coast-min-fast-intervals:
    type: int
    default: 4
    description: Minimum consecutive fast same-direction intervals to arm glide

binding-cells:
  - direction
```
